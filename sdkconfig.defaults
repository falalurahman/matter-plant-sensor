## sdkconfig.defaults
```kconfig
# FreeRTOS - Arduino requires 1000Hz tick rate
CONFIG_FREERTOS_HZ=1000
CONFIG_AUTOSTART_ARDUINO=y

# Log Levels
CONFIG_BOOTLOADER_LOG_LEVEL_ERROR=y
CONFIG_ARDUHAL_LOG_DEFAULT_LEVEL_INFO=y
CONFIG_LOG_DEFAULT_LEVEL_ERROR=y

# Flash/Monitor
CONFIG_ESPTOOLPY_BAUD_921600B=y
CONFIG_ESPTOOLPY_BAUD=921600
CONFIG_ESPTOOLPY_COMPRESSED=y
CONFIG_ESPTOOLPY_MONITOR_BAUD_115200B=y
CONFIG_ESPTOOLPY_MONITOR_BAUD=115200
CONFIG_ESPTOOLPY_FLASHSIZE_4MB=y

# BLE for commissioning
CONFIG_BT_ENABLED=y
CONFIG_BT_NIMBLE_ENABLED=y
# CONFIG_BT_NIMBLE_ENABLE_CONN_REATTEMPT is not set
# CONFIG_BT_NIMBLE_EXT_ADV is not set
CONFIG_BT_NIMBLE_HCI_EVT_BUF_SIZE=70

# Custom partition table
CONFIG_PARTITION_TABLE_CUSTOM=y
CONFIG_PARTITION_TABLE_FILENAME="partitions.csv"

# Disable chip shell
# CONFIG_ENABLE_CHIP_SHELL is not set

# LwIP route hooks (required for Matter)
CONFIG_LWIP_HOOK_IP6_ROUTE_DEFAULT=y
CONFIG_LWIP_HOOK_ND6_GET_GW_DEFAULT=y

# Disable DS Peripheral
# CONFIG_ESP_SECURE_CERT_DS_PERIPHERAL is not set

# Matter NVS storage
CONFIG_ESP_MATTER_NVS_USE_COMPACT_ATTR_STORAGE=y

# mbedTLS HKDF (required by Matter)
CONFIG_MBEDTLS_HKDF_C=y

# libsodium
CONFIG_LIBSODIUM_USE_MBEDTLS_SHA=y

# FreeRTOS legacy API
CONFIG_FREERTOS_ENABLE_BACKWARD_COMPATIBILITY=y

# mDNS
CONFIG_ENABLE_EXTENDED_DISCOVERY=y
```

## sdkconfig.defaults.esp32h2
```kconfig
# ESP32-H2: Matter over Thread

# Disable WiFi (H2 has no WiFi radio)
# CONFIG_ESP_WIFI_ENABLED is not set
# CONFIG_ENABLE_WIFI_STATION is not set
# CONFIG_ENABLE_WIFI_AP is not set
# CONFIG_USE_BLE_ONLY_FOR_COMMISSIONING is not set

# Enable OpenThread
CONFIG_OPENTHREAD_ENABLED=y
CONFIG_OPENTHREAD_SRP_CLIENT=y
CONFIG_OPENTHREAD_DNS_CLIENT=y
# CONFIG_OPENTHREAD_LOG_LEVEL_DYNAMIC is not set
CONFIG_OPENTHREAD_LOG_LEVEL_NOTE=y
# CONFIG_OPENTHREAD_CLI is not set

# LwIP for Thread
# CONFIG_LWIP_IPV6_AUTOCONFIG is not set
CONFIG_LWIP_IPV6_NUM_ADDRESSES=8
CONFIG_LWIP_MULTICAST_PING=y

# Use platform mDNS for Thread (not minimal)
# CONFIG_USE_MINIMAL_MDNS is not set

# MRP configs for Thread
CONFIG_MRP_LOCAL_ACTIVE_RETRY_INTERVAL_FOR_THREAD=5000
CONFIG_MRP_LOCAL_IDLE_RETRY_INTERVAL_FOR_THREAD=5000
CONFIG_MRP_RETRY_INTERVAL_SENDER_BOOST_FOR_THREAD=5000
CONFIG_MRP_MAX_RETRANS=3

# Subscription persistence: device proactively re-establishes subscriptions
# after deep sleep wakeup instead of waiting for controllers to re-subscribe.
# Maps to CHIP_CONFIG_PERSIST_SUBSCRIPTIONS + CHIP_CONFIG_SUBSCRIPTION_TIMEOUT_RESUMPTION.
CONFIG_ENABLE_PERSIST_SUBSCRIPTIONS=y

# ICD (Long Idle Time) — SED that sleeps for hours
# LIT + CIP required so controllers (Apple Home) don't mark device offline.
# IMPORTANT: CONFIG_ICD_IDLE_MODE_INTERVAL_SEC must match ICD_WAKE_INTERVAL_S
# in platformio.ini. If they diverge, Apple Home sets subscription MaxInterval
# from the advertised value and the subscription expires (~18 min with 900s
# default), causing "no active subscriptions" on wake. Testing=120s, prod=3600s.
CONFIG_ENABLE_ICD_SERVER=y
CONFIG_ENABLE_ICD_LIT=y
CONFIG_ENABLE_ICD_CIP=y
CONFIG_ICD_IDLE_MODE_INTERVAL_SEC=120
CONFIG_ICD_ACTIVE_MODE_INTERVAL_MS=10000
CONFIG_ICD_ACTIVE_MODE_THRESHOLD_MS=5000
CONFIG_ICD_SLOW_POLL_INTERVAL_MS=1000
CONFIG_ICD_FAST_POLL_INTERVAL_MS=200
CONFIG_ICD_REPORT_ON_ACTIVE_MODE=y

# Radio sleep (reduces current draw during active periods and any light-sleep phases)
CONFIG_IEEE802154_SLEEP_ENABLE=y
CONFIG_BT_LE_SLEEP_ENABLE=y

# Flash power-down and peripheral power-down during sleep
CONFIG_ESP_SLEEP_POWER_DOWN_FLASH=y
CONFIG_PM_ENABLE=y
CONFIG_PM_DFS_INIT_AUTO=y
CONFIG_PM_POWER_DOWN_PERIPHERAL_IN_LIGHT_SLEEP=y
```
